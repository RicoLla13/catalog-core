## intercept-bench-micro/configs/qemu.x86_64.base.defconfig
```kconfig
CONFIG_PLAT_KVM=y
# CONFIG_LIBUKMMAP is not set
CONFIG_ARCH_X86_64=y
CONFIG_UK_NAME="intercept-bench-micro"
```

## intercept-bench-sqlite/configs/qemu.x86_64.base.defconfig
```kconfig
CONFIG_PLAT_KVM=y
# CONFIG_LIBUKMMAP is not set
CONFIG_ARCH_X86_64=y
CONFIG_UK_NAME="intercept-bench-sqlite"
CONFIG_LIBMUSL=y
# CONFIG_LWIP_NETIF_STATUS_PRINT is not set
# CONFIG_LWIP_NETIF_EXT_STATUS_CALLBACK is not set
```

## intercept-pathmeta/configs/qemu.x86_64.defconfig
```kconfig
CONFIG_PLAT_KVM=y
CONFIG_ARCH_X86_64=y
CONFIG_UK_NAME="intercept-pathmeta"
CONFIG_LIBINTERCEPT=y
CONFIG_LIBINTERCEPT_TRANSPORT_SOCKET=y
CONFIG_LIBINTERCEPT_REMOTE_IPV4="172.44.0.1"
CONFIG_LIBINTERCEPT_REMOTE_PORT=9999
# CONFIG_LIBINTERCEPT_CONNECT_ON_FIRST_RPC is not set
# CONFIG_LIBINTERCEPT_CONNECT_BOOT_BEST_EFFORT is not set
CONFIG_LIBINTERCEPT_CONNECT_BOOT_REQUIRED=y
CONFIG_LIBMUSL=y
# CONFIG_LWIP_NETIF_STATUS_PRINT is not set
# CONFIG_LWIP_NETIF_EXT_STATUS_CALLBACK is not set
```
